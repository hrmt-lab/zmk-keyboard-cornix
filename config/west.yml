## config/west.yml
```yaml
manifest:
  remotes:
    - name: zmkfirmware
      url-base: https://github.com/zmkfirmware
    - name: hitsmaxft
      url-base: https://github.com/hitsmaxft
    - name: urob
      url-base: https://github.com/urob
    # - name: janpfischer
    #   url-base: https://github.com/janpfischer
    # Prospector  
    - name: carrefinho
      url-base: https://github.com/carrefinho
  projects:
    - name: zmk
      remote: zmkfirmware
      revision: ac7f75b8591d39aaf3b66b9d26f26c9ed921a009
      clone-depth: 1
      import:
        file: app/west.yml
    - name: zmk-helpers
      remote: urob
      revision: main
      clone-depth: 1
    #- name: zmk-rgbled-widget
    #  remote: hitsmaxft
    #  revision: main
    #  clone-depth: 1
    # - name: zmk-dongle-display
    #   remote: hitsmaxft
    #   revision: zephyr4
    #   clone-depth: 1
    # - name: zmk-dongle-screen
    #   remote: janpfischer
    #   revision: upgrade-4.1
    #   clone-depth: 1
    # Prospector  
    - name: prospector-zmk-module
      remote: carrefinho
      revision: feat/new-status-screens
    - name: zmk-keyboard-cornix
      remote: cornix-shield
      revision: main
  self:
    path: config
```
